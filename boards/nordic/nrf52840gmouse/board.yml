## boards/nordic/nrf52840gmouse/board.yml
```yaml
board:
  name: nrf52840gmouse
  full_name: nRF52840 GMouse
  vendor: nordic
  socs:
    - name: nrf52840
```

## boards/nordic/nrf52dmouse/board.yml
```yaml
board:
  name: nrf52dmouse
  full_name: nRF52 DMouse
  vendor: nordic
  socs:
    - name: nrf52832
```

## boards/nordic/nrf52kbd/board.yml
```yaml
board:
  name: nrf52kbd
  full_name: nRF52 Kbd
  vendor: nordic
  socs:
    - name: nrf52832
```
